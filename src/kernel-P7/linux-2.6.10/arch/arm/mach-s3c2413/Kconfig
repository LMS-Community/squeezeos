## src/kernel-P7/linux-2.6.10/arch/arm/mach-s3c2413/Kconfig
```kconfig
if ARCH_S3C2413

menu "S3C24XX Implementations"


config ARCH_SMDK2413
	bool "SMDK2413"
	select CPU_S3C2413
	help
	   Say Y here if you are using the SMDK2413 

config ARCH_SMDK2411
	bool "SMDK2411"
	help
	   Say Y here if you are using the SMDK2411

endmenu

config CPU_S3C2413
	bool
	depends on ARCH_S3C2413
	help
	  Support for S3C2413 Samsung Mobile CPU based systems.

comment "S3C2413 Setup"

config S3C2413_DMA
	bool "S3C2413 DMA support"
	depends on ARCH_S3C2413
	help
	  S3C2413 DMA support. This is needed for drivers like sound which
	  use the S3C2413's DMA system to move data to and from the
	  peripheral blocks.

config S3C2413_DMA_DEBUG
	bool "S3C2413 DMA support debug"
	depends on ARCH_S3C2413 && S3C2413_DMA
	help
	  Enable debugging output for the DMA code. This option sends info
	  to the kernel log, at priority KERN_DEBUG.

	  Note, it is easy to create and fill the log buffer in a small
	  amount of time, as well as using an significant percentage of
	  the CPU time doing so.


config S3C2413_PM_DEBUG
	bool "S3C2413 PM Suspend debug"
	depends on ARCH_S3C2413 && PM
	help
	  Say Y here if you want verbose debugging from the PM Suspend and
	  Resume code. See `Documentation/arm/Samsing-S3C24XX/Suspend.txt`
	  for more information.

config S3C2413_PM_CHECK
	bool "S3C2413 PM Suspend Memory CRC"
	depends on ARCH_S3C2413 && PM && CRC32
	help
 	  Enable the PM code's memory area checksum over sleep. This option
	  will generate CRCs of all blocks of memory, and store them before
	  going to sleep. The blocks are then checked on resume for any
	  errors.

config S3C2413_PM_CHECK_CHUNKSIZE
	int "S3C2413 PM Suspend CRC Chunksize (KiB)"
	depends on ARCH_S3C2413 && PM && S3C2413_PM_CHECK
	default 64
	help
	  Set the chunksize in Kilobytes of the CRC for checking memory
	  corruption over suspend and resume. A smaller value will mean that
	  the CRC data block will take more memory, but wil identify any
	  faults with better precision.

config S3C2413_LOWLEVEL_UART_PORT
	int "S3C2413 UART to use for low-level messages"
	default 0
	help
	  Choice of which UART port to use for the low-level messages,
	  such as the `Uncompressing...` at start time. The value of
	  this configuration should be between zero and two. The port
	  must have been initialised by the boot-loader before use.

	  Note, this does not affect the port used by the debug messages,
	  which is a separate configuration.

endif
```

## src/kernel-P7/linux-2.6.10/drivers/char/jive/Kconfig
```kconfig
#
# Jive BSP
#

menu "Jive Hardware"

config JIVE_DRIVER
	bool "Jive Hardware Support"
	
config JIVE_MATRIX
	tristate "Key Matrix Support"
	depends on JIVE_DRIVER

config JIVE_WHEEL
	tristate "Wheel Driver Support"
	depends on JIVE_DRIVER

config JIVE_MGMT
	tristate "Jive BSP Driver"
	depends on JIVE_DRIVER

config JIVE_IRTX
	tristate "Jive IR transmit Driver"
	depends on JIVE_DRIVER

endmenu
```

## src/kernel-P7/linux-2.6.10/drivers/l3/Kconfig
```kconfig
#
# L3 bus configuration
#

menu "L3 serial bus support"

config L3
	tristate "L3 support"

config L3_ALGOBIT
	bool "L3 bit-banging interfaces"
	depends on L3=y

config L3_BIT_SA1100_GPIO
	bool "SA11x0 GPIO adapter"
	depends on L3_ALGOBIT && ARCH_SA1100
	
# i2c must come before this
config BIT_SA1100_GPIO
	bool
	depends on L3_BIT_SA1100_GPIO || I2C_BIT_SA1100_GPIO=y
	default y

config L3_BIT_S3C2413_GPIO
	bool "S3C2413 GPIO adapter"
	depends on L3_ALGOBIT && ARCH_S3C2413
	
endmenu
```

## src/kernel-P7/linux-2.6.10/drivers/spi/Kconfig
```kconfig
#
# Character device configuration
#

menu "SPI support"

config SPI
	tristate "SPI support"
	---help---
	  SPI is a serial bus protocol used in
	  many micro controller applications.

	  If you want SPI support, you should say Y here and also to the
	  specific driver for your bus adapter(s) below.

	  This SPI support can also be built as a module.  If so, the module
	  will be called spi-core.

source drivers/spi/busses/Kconfig

config SPI_DEBUG_CORE
	bool "SPI Core debugging messages"
	depends on SPI
	help
	  Say Y here if you want the SPI core to produce a bunch of debug
	  messages to the system log.  Select this if you are having a
	  problem with SPI support and want to see more of what is going on.

config SPI_DEBUG_BUS
	bool "SPI Bus debugging messages"
	depends on SPI
	help
	  Say Y here if you want the SPI bus drivers to produce a bunch of
	  debug messages to the system log.  Select this if you are having
	  a problem with SPI support and want to see more of what is going
	  on.

endmenu
```

## src/kernel-P7/linux-2.6.22/arch/arm/mach-s3c2440/Kconfig
```kconfig
# arch/arm/mach-s3c2440/Kconfig
#
# Copyright 2007 Simtec Electronics
#
# Licensed under GPLv2

config CPU_S3C2440
	bool
	depends on ARCH_S3C2410
	select S3C2410_CLOCK
	select S3C2410_PM if PM
	select S3C2410_GPIO
	select S3C2440_DMA if S3C2410_DMA
	select CPU_S3C244X
	help
	  Support for S3C2440 Samsung Mobile CPU based systems.

config S3C2440_DMA
	bool
	depends on ARCH_S3C2410 && CPU_S3C24405B
	help
	  Support for S3C2440 specific DMA code5A

config S3C2440_CPUFREQ
	bool
	depends on CPU_FREQ && (CPU_S3C2440 || CPU_S3C2442)
	select S3C2410_IOTIMING
	default y
	help
	  CPU Frequency scaling support for S3C2440 and S3C2440 SoC CPUs.

# Main system crystal selection

config S3C2440_XTAL_12000000
	bool
	help
	  Indicate that the build needs to support 12MHz system
	  crystal.

config S3C2440_XTAL_16934400
	bool
	help
	  Indicate that the build needs to support 16.9344MHz system
	  crystal.

# PLL table selection

config S3C2440_PLL_12000000
	bool
	depends on S3C2440_CPUFREQ && S3C2440_XTAL_12000000
	default y if CPU_FREQ_S3C24XX_PLL
	help
	  PLL tables for S3C2440 CPUs with 12MHz input crystals.

config S3C2440_PLL_16934400
	bool
	depends on S3C2440_CPUFREQ && S3C2440_XTAL_16934400
	default y if CPU_FREQ_S3C24XX_PLL
	help
	  PLL tables for S3C2440 CPUs with 12MHz input crystals.

menu "S3C2440 Machines"

config MACH_ANUBIS
	bool "Simtec Electronics ANUBIS"
	select CPU_S3C2440
	select PM_SIMTEC if PM
	select S3C2440_XTAL_12000000
	help
	  Say Y here if you are using the Simtec Electronics ANUBIS
	  development system

config MACH_OSIRIS
	bool "Simtec IM2440D20 (OSIRIS) module"
	select CPU_S3C2440
	select PM_SIMTEC if PM
	select S3C2440_XTAL_12000000
	help
	  Say Y here if you are using the Simtec IM2440D20 module, also
	  known as the Osiris.

config MACH_RX3715
	bool "HP iPAQ rx3715"
	select CPU_S3C2440
	select S3C2440_XTAL_16934400
	select PM_H1940 if PM
	help
	  Say Y here if you are using the HP iPAQ rx3715.

config ARCH_S3C2440
	bool "SMDK2440"
	select CPU_S3C2440
	select S3C2440_XTAL_16934400
	select MACH_SMDK
	help
	  Say Y here if you are using the SMDK2440.

config MACH_NEXCODER_2440
 	bool "NexVision NEXCODER 2440 Light Board"
 	select CPU_S3C2440
	select S3C2440_XTAL_12000000
	help
 	  Say Y here if you are using the Nex Vision NEXCODER 2440 Light Board

config SMDK2440_CPU2440
	bool "SMDK2440 with S3C2440 CPU module"
	depends on ARCH_S3C2440
	default y if ARCH_S3C2440
	select S3C2440_XTAL_16934400
	select CPU_S3C2440

endmenu
```

## src/kernel-P7/linux-2.6.22/drivers/char/jive/Kconfig
```kconfig
# drivers/char/jive/Makefile

menu "Jive hardware driver support"

config JIVE_DRIVER
	bool "Jive hardware support"
	depends on MACH_JIVE

config JIVE_IRTX
	tristate "Jive IR transmit Driver"
	depends on JIVE_DRIVER

config JIVE_MGMT
	tristate "Jive hardware mangement Driver"
	depends on JIVE_DRIVER

config JIVE_WHEEL
	tristate "Jive Wheel Driver"
	depends on JIVE_DRIVER

config JIVE_WHEEL_LEVELIRQ
	bool "Use level instead of edge IRQ triggering"
	depends on JIVE_WHEEL
	help
	  Say Y if you want to use level IRQ mode for the wheel
	  switch instead of edge triggering	

config JIVE_MATRIX
	tristate "Jive keyboard matrix Driver"

endmenu
```

## src/kernel-P7/linux-2.6.22/sound/soc/codecs/Kconfig
```kconfig
config SND_SOC_AC97_CODEC
	tristate
	depends on SND_SOC

config SND_SOC_WM8731
	tristate
	depends on SND_SOC

config SND_SOC_WM8750
	tristate
	depends on SND_SOC

config SND_SOC_WM8750_I2C
	tristate
	select SND_SOC_WM8750
	depends on SND_SOC && (CONFIG_I2C || CONFIG_I2C_MODULE)

config SND_SOC_WM8750_SPI
	tristate
	select SND_SOC_WM8750
	depends on SND_SOC && CONFIG_SPI

config SND_SOC_WM8753
	tristate
	depends on SND_SOC

config SND_SOC_WM9712
	tristate
	depends on SND_SOC
```

## src/s3c2412/linux-2.6.22/drivers/char/jive/Kconfig
```kconfig
# drivers/char/jive/Makefile

menu "Jive hardware driver support"

config JIVE_DRIVER
	bool "Jive hardware support"
	depends on MACH_JIVE

config JIVE_IRTX
	tristate "Jive IR transmit Driver"
	depends on JIVE_DRIVER

config JIVE_MGMT
	tristate "Jive hardware mangement Driver"
	depends on JIVE_DRIVER

config JIVE_WHEEL
	tristate "Jive Wheel Driver"
	depends on JIVE_DRIVER

config JIVE_MATRIX
	tristate "Jive keyboard matrix Driver"

endmenu
```
