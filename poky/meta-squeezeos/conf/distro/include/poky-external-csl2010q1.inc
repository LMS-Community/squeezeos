## src/kernel-P4/linux-2.6.10/drivers/char/yamu/Kconfig
```kconfig
#
# Yamu Solutions device driver configuration
#

menu "Yamu Solutions Driver"

config YAMU_DRIVER
	bool "Yamu Solutions Driver Support"
	help
		This is yamu2412 driver for kernel 2.6.x
	
config KeyBackLightDIMM
	tristate "Keypad backlight Dimming Driver support"
	depends on YAMU_DRIVER
	help
		Keypad backlight driver

config MATRIX
	tristate "Matrix key Driver support"
	depends on YAMU_DRIVER
	help
		Matrix key driver

#config HOLD 
#	tristate "Hold key Driver support"
#	depends on YAMU_DRIVER
#	help 
#		Hold key driver

config BATTERY 
	tristate "Battery ADC Driver support"
	depends on YAMU_DRIVER
	help 
		Battery ADC driver

#config LCDP
#	tristate "LCD power Driver support"
#	depends on YAMU_DRIVER
#	help
#		LCD power driver
		
config HDET
	tristate "Headphone detection Driver support"
	depends on YAMU_DRIVER

#config DACP
#	tristate "DAC power control Driver support"
#	depends on YAMU_DRIVER
	
#config AMPP
#	tristate "AMP power control Driver support"
#	depends on YAMU_DRIVER

#config MuteTR
#	tristate "Mute TR control Driver support"
#	depends on YAMU_DRIVER
	
config WLANP
	tristate "Wireless lan power control Driver support"
	depends on YAMU_DRIVER

config WLAN_DC_EN
	tristate "Wireless lan WLAN_DC_EN control Driver support"
	depends on YAMU_DRIVER

config WLAN_SLEEP_CLK
	tristate "Wireless lan WLAN_SLEEP_CLK control Driver support"
	depends on YAMU_DRIVER
	
config MOTION
	tristate "Motion sensor Input Driver support"
	depends on YAMU_DRIVER

config ACCEL
	tristate "Motion sensor control Driver support"
	depends on YAMU_DRIVER
	
config LCDDIMM
	tristate "LCD backlight dimming control (PWM) Driver support"
	depends on YAMU_DRIVER

config IRTX
	tristate "IR Transmitte driver support"
	depends on YAMU_DRIVER

#config IRRX
#	tristate "IR Recieve driver support"
#	depends on YAMU_DRIVER

config WHEEL
	tristate "Wheel driver support"
	depends on YAMU_DRIVER

config PMODE
	tristate "Power Mode driver support"
	depends on YAMU_DRIVER

config LcdReset
	tristate "LcdReset Mode driver support"
	depends on YAMU_DRIVER

#config LCDBacklightEn
#	tristate "LCD Backlight Enable Mode driver support"
#	depends on YAMU_DRIVER

#config MuteFET
#	tristate "Mute FET Mode driver support"
#	depends on YAMU_DRIVER

config NANDWP
	tristate "Nand nWP driver support"
	depends on YAMU_DRIVER
	
#config AG_OUT
#	tristate "WM8750 AG_OUT driver support"
#	depends on YAMU_DRIVER	

#config BT_PRIORITY
#	tristate "WLAN BT_PRIORITY  driver support"
#	depends on YAMU_DRIVER	
	
config CHG_ACPR
	tristate "Charger CHG_ACPR driver support"
	depends on YAMU_DRIVER	
	
config CHG_HPWR
	tristate "Charger CHG_HPWR driver support"
	depends on YAMU_DRIVER
	
config CHG_PPR
	tristate "Charger CHG_PPR driver support"
	depends on YAMU_DRIVER
	
config CHG_SUSP
	tristate "Charger CHG_SUSP driver support"
	depends on YAMU_DRIVER
	
config DOCKDET
	tristate "DOCK DETECT driver support"
	depends on YAMU_DRIVER	
	
config DOCKDET_AD
	tristate "DOCK DETECT AD driver support"
	depends on YAMU_DRIVER
	
config WLAN_nRESET
	tristate "WLAN nRESET  driver support"
	depends on YAMU_DRIVER	
	
config WLAN_SPI_nINT
	tristate "WLAN_SPI_nINT driver support"
	depends on YAMU_DRIVER
	
config WM8750_REG
	tristate "WM8750_REG driver support"
	depends on YAMU_DRIVER	

config SW_PW_OFF
	tristate "PIC IC SW_PW_OFF driver support"
	depends on YAMU_DRIVER	
		
endmenu
```

## src/kernel-P4/linux-2.6.10/drivers/input/touchscreen/Kconfig
```kconfig
#
# Mouse driver configuration
#
config INPUT_TOUCHSCREEN
	bool "Touchscreens"
	depends on INPUT
	help
	  Say Y here, and a list of supported touchscreens will be displayed.
	  This option doesn't affect the kernel.

	  If unsure, say Y.

config TOUCHSCREEN_BITSY
	tristate "Compaq iPAQ H3600 (Bitsy) touchscreen input driver"
	depends on SA1100_BITSY && INPUT && INPUT_TOUCHSCREEN
	select SERIO
	help
	  Say Y here if you have the h3600 (Bitsy) touchscreen.

	  If unsure, say N.

	  To compile this driver as a module, choose M here: the
	  module will be called h3600_ts_input.

config TOUCHSCREEN_GUNZE
	tristate "Gunze AHL-51S touchscreen"
	depends on INPUT && INPUT_TOUCHSCREEN
	select SERIO
	help
	  Say Y here if you have the Gunze AHL-51 touchscreen connected to
	  your system.

	  If unsure, say N.

	  To compile this driver as a module, choose M here: the
	  module will be called gunze.

config TOUCHSCREEN_S3C2440
	tristate "S3C2440 touchscreen"
	depends on INPUT && INPUT_TOUCHSCREEN
	help
	  Say Y here if you have the touchscreen S3C2440 touchscreen

	  If unsure, say N.

	  To compile this driver as a module, choose M here: the
	  module will be called s3c2440_ts.

config S3C2440_TSHOOK
	boolean "Touch-Repeat Support"
	depends on TOUCHSCREEN_S3C2440
	default y

config S3C2440_ADC_POLLING
	boolean "ADC In Polling Mode"
	depends on TOUCHSCREEN_S3C2440
	default n

config TOUCHSCREEN_S3C2413
	tristate "S3C2413 touchscreen"
	depends on INPUT && INPUT_TOUCHSCREEN
	help
	  Say Y here if you have the touchscreen S3C2413 touchscreen

	  If unsure, say N.

	  To compile this driver as a module, choose M here: the
	  module will be called s3c2413_ts.

config S3C2413_TSHOOK
	boolean "Touch-Repeat Support"
	depends on TOUCHSCREEN_S3C2413
	default y
config S3C2413_TS_OLD_API
	boolean "Use the 2.4 kernel touch screen API"
	depends on TOUCHSCREEN_S3C2413
	default y


config S3C2413_ADC_POLLING
	boolean "ADC In Polling Mode"
	depends on TOUCHSCREEN_S3C2413
	default n
```

## src/kernel-P4/linux-2.6.10/drivers/spi/busses/Kconfig
```kconfig
#
# Sensor device configuration
#

menu "SPI Hardware Bus support"
	depends on SPI

config SPI_S3C2413
	tristate "S3C2413 SPI Driver"
	depends on SPI && ARCH_S3C2413
	help
	  Say Y here to include support for SPI controller in the
	  Samsung S3C2413 based System-on-Chip devices.

endmenu
```
