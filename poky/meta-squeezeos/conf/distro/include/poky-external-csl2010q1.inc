## poky/meta-squeezeos/conf/distro/include/poky-external-csl2010q1.inc
```bitbake
#
# Poky configuration to use external CSL 2010q1 toolchain (ARM EABI)
#

TARGET_VENDOR = "-none"

PREFERRED_PROVIDER_linux-libc-headers = "external-csl-toolchain"
PREFERRED_PROVIDER_virtual/arm-none-linux-gnueabi-gcc = "external-csl-toolchain"
PREFERRED_PROVIDER_virtual/arm-none-linux-gnueabi-gcc-initial = "external-csl-toolchain"
PREFERRED_PROVIDER_virtual/arm-none-linux-gnueabi-gcc-intermediate = "external-csl-toolchain"
PREFERRED_PROVIDER_virtual/arm-none-linux-gnueabi-binutils = "external-csl-toolchain"
PREFERRED_PROVIDER_virtual/arm-none-linux-gnueabi-libc-for-gcc = "external-csl-toolchain"
PREFERRED_PROVIDER_virtual/libc = "external-csl-toolchain"
PREFERRED_PROVIDER_virtual/libintl = "external-csl-toolchain"
PREFERRED_PROVIDER_virtual/libiconv = "external-csl-toolchain"
PREFERRED_PROVIDER_glibc-thread-db = "external-csl-toolchain"
PREFERRED_PROVIDER_virtual/linux-libc-headers = "external-csl-toolchain"

PREFERRED_VERSION_external-csl-toolchain = "2010q1-202"

TOOLCHAIN_OPTIONS = " --sysroot=${STAGING_DIR_HOST}"
```

## poky/meta-squeezeos/conf/distro/squeezeos.conf
```bitbake
#@TYPE: Distribution
#@NAME: Logitech SqueezeOS Linux
#@DESCRIPTION: Distribution configuration for Logitech SqueezeOS Linux

require conf/distro/poky.conf

DISTRO = "squeezeos"
DISTRO_NAME = "Logitech SqueezeOS Linux"

SQUEEZEOS_DISTRO_VERSION ?= "10.1"
SQUEEZEOS_DISTRO_RELEASE ?= "10.1.0"
DISTRO_VERSION = "${SQUEEZEOS_DISTRO_VERSION}"
DISTRO_RELEASE = "${SQUEEZEOS_DISTRO_RELEASE}"

MAINTAINER = "Logitech SqueezeOS <debian@slimdevices.com>"

# Mirror site for cvs/svn/git packages
# FIXME!
CVS_TARBALL_STASH = ""

DISTRO_FEATURES = "alsa usbgadget usbhost wifi nfs zeroconf"

# This causes build problems, disable it for now
#INHERIT += "pkg_metainfo"

# Add support for ubi images
IMAGE_CMD_ubi = "echo -e ${IMAGE_UBI_CONFIG} > ${TMPDIR}/ubi.cfg && ubinize -o ${DEPLOY_DIR_IMAGE}/${IMAGE_NAME}.rootfs.ubi -m ${IMAGE_UBI_MIN_IO_SIZE} -p ${IMAGE_UBI_PEB_SIZE} -s ${IMAGE_UBI_SUB_PAGE_SIZE} ${EXTRA_IMAGECMD} ${TMPDIR}/ubi.cfg"
IMAGE_DEPENDS_ubi = "mtd-utils-native"

# SqueezeOS/SqueezePlay SCM
SQUEEZEOS_SVN ?= "git://github.com/Logitech/squeezeos.git;branch=${DISTRO_VERSION};repopath=src;protocol=git"
SQUEEZEPLAY_SCM ?= "git://github.com/Logitech/squeezeplay.git;branch=${DISTRO_VERSION};repopath=src;protocol=git"

# This gets evaluated even though slimserver is not built for this target on this branch ...
# SQUEEZECENTER_SCM ?= "git://github.com/Logitech/slimserver.git;branch=${DISTRO_VERSION};protocol=git"
SQUEEZECENTER_SCM ?= "git://github.com/Logitech/slimserver.git;branch=7.8;protocol=git"

# Build all packages to the same revision as the squeezeos-poky checkout, based on the
# metadata revision. To get a newer build you need to do an 'svn update' in poky first
SQUEEZEOS_REVISION = "${METADATA_REVISION}"


# SqueezePlay application
SRCREV_pn-squeezeplay ?= "${AUTOREV}"
SRCREV_pn-squeezeplay-baby ?= "${AUTOREV}"
SRCREV_pn-squeezeplay-fab4 ?= "${AUTOREV}"
SRCREV_pn-squeezeplay-jive ?= "${AUTOREV}"
SRCREV_pn-squeezeplay-squeezeos ?= "${AUTOREV}"

# SqueezePlay dependancies
SRCREV_pn-libsdl-image ?= "${AUTOREV}"
SRCREV_pn-libsdl ?= "${AUTOREV}"
SRCREV_pn-libsdl-ttf ?= "${AUTOREV}"
SRCREV_pn-libsdl-gfx ?= "${AUTOREV}"
SRCREV_pn-freefont ?= "${AUTOREV}"
SRCREV_pn-luaprofiler ?= "${AUTOREV}"
SRCREV_pn-luasocket ?= "${AUTOREV}"
SRCREV_pn-lualoop ?= "${AUTOREV}"
SRCREV_pn-luajson ?= "${AUTOREV}"
SRCREV_pn-luafilesystem ?= "${AUTOREV}"
SRCREV_pn-luazipfilter ?= "${AUTOREV}"
SRCREV_pn-lua ?= "${AUTOREV}"
SRCREV_pn-lua-native ?= "${AUTOREV}"
SRCREV_pn-luatolua++ ?= "${AUTOREV}"
SRCREV_pn-luamd5 ?= "${AUTOREV}"
SRCREV_pn-luaexpat ?= "${AUTOREV}"
SRCREV_pn-luartmp ?= "${AUTOREV}"

# SqueezeCenter
SRCREV_pn-squeezecenter ?= "${AUTOREV}"
SRCREV_pn-squeezecenter_full ?= "${AUTOREV}"

# SqueezeOS
SRCREV_pn-linux-imx25 ?= "${AUTOREV}"
SRCREV_pn-linux-fab4 ?= "${AUTOREV}"
SRCREV_pn-linux-jive ?= "${AUTOREV}"
SRCREV_pn-jivetest ?= "${AUTOREV}"
SRCREV_pn-marvell-sdio-module-src = "${AUTOREV}"

# Audio::Scan
SRCREV_pn-libaudio-scan-perl ?= "${AUTOREV}"

# Tremor
SRCREV_pn-tremor ?= "${AUTOREV}"


# to build these closed source packages from source, modify your local.conf
PREFERRED_PROVIDER_marvell-wlan-tools ?= "marvell-wlan-tools-bin"
PREFERRED_PROVIDER_marvell-gspi-module ?= "marvell-gspi-module-bin"
PREFERRED_PROVIDER_marvell-wps ?= "marvell-wps-bin"
PREFERRED_PROVIDER_atheros-ar6-module ?= "atheros-ar6-module-bin"
PREFERRED_PROVIDER_atheros-ar63-module ?= "atheros-ar63-module-bin"
PREFERRED_PROVIDER_squeezeos-dsp ?= "squeezeos-dsp-bin"
PREFERRED_PROVIDER_baby-msp430 ?= "baby-msp430-bin"


PREFERRED_VERSION_busybox ?= "1.18.2"
PREFERRED_VERSION_qemu-native ?= "0.9.1"
PREFERRED_VERSION_freetype ?= "2.1.10"
PREFERRED_VERSION_oprofile ?= "0.9.6"
```

## poky/meta-squeezeos/conf/machine/baby.conf
```bitbake
#@TYPE: Machine
#@NAME: Logitech Squeezebox BabyBoom (baby)
#@DESCRIPTION: Machine configuration for the Logitech Squeezebox BabyBoom
TARGET_ARCH = "arm"
PACKAGE_EXTRA_ARCHS = "armv4 armv4t armv5te"

# Enable thumb for baby
ARM_INSTRUCTION_SET = "thumb"
THUMB_INTERWORK = "yes"

PREFERRED_PROVIDER_virtual/kernel = "linux-imx25"

MACHINE_FEATURES = "kernel26 alsa screen"

# use an uncompressed kernel for a faster boot
KERNEL_IMAGETYPE = "Image"

IMAGE_FSTYPES ?= "cramfs ubi"

IMAGE_UBI_MIN_IO_SIZE ?= "2048"
IMAGE_UBI_PEB_SIZE ?= "131072"
IMAGE_UBI_SUB_PAGE_SIZE ?= "512"
IMAGE_UBI_CONFIG ?= "[kernel]\\n\
mode=ubi\\n\
image=${DEPLOY_DIR_IMAGE}/${KERNEL_IMAGE_NAME}\\n\
vol_id=0\\n\
vol_size=4MiB\\n\
vol_type=static\\n\
vol_name=kernel\\n\
vol_alignment=1\\n\
\\n\
[cramfs]\\n\
mode=ubi\\n\
image=${DEPLOY_DIR_IMAGE}/${ROOTFS_IMAGE_NAME}\\n\
vol_id=1\\n\
vol_size=30MiB\\n\
vol_type=static\\n\
vol_name=cramfs\\n\
vol_alignment=1\\n\
\\n\
[ubifs]\\n\
mode=ubi\\n\
vol_id=2\\n\
vol_size=10MiB\\n\
vol_type=dynamic\\n\
vol_name=ubifs\\n\
vol_alignment=1\\n\
\\n\
"

SERIAL_CONSOLE = "-L 115200 tts/1"

IMAGE_INSTALL += "jivetest"
IMAGE_INSTALL += "atheros-ar6-module"
IMAGE_INSTALL += "wpasupplicant"

IMAGE_INSTALL += "squeezeplay-baby"
IMAGE_INSTALL += "squeezeplay-qvgaskin squeezeplay-babyskin"
IMAGE_INSTALL += "squeezeplay-squeezeos"
IMAGE_INSTALL += "squeezeos-dsp"
IMAGE_INSTALL += "baby-msp430"
IMAGE_INSTALL += "monitor-hardware"

IMAGE_SQUEEZEOS_UPGRADE = "1"
IMAGE_SQUEEZEOS_BOARD_VERSION = "\
baby:0001\\n\
baby:0002\\n\
baby:0003\\n\
baby:0004\\n\
baby:0005\\n\
baby:0006\\n\
baby:0007\\n\
baby:25000\\n\
"

require conf/machine/include/tune-arm926ejs.inc
```

## poky/meta-squeezeos/conf/machine/fab4.conf
```bitbake
#@TYPE: Machine
#@NAME: Logitech Squeezebox Controller (Jive)
#@DESCRIPTION: Machine configuration for the Logitech Squeezebox Controller
TARGET_ARCH = "arm"
PACKAGE_EXTRA_ARCHS = "armv4 armv4t armv5te armv6"

# Enable thumb for fab4
ARM_INSTRUCTION_SET = "thumb"
THUMB_INTERWORK = "yes"
TARGET_CC_KERNEL_ARCH = "-mthumb-interwork -mno-thumb"

# Need to use -Os rather than the default -O2
FULL_OPTIMIZATION = "-Os -fexpensive-optimizations -fomit-frame-pointer -frename-registers -ggdb -feliminate-unused-debug-types"

PREFERRED_PROVIDER_virtual/kernel = "linux-fab4"

MACHINE_FEATURES = "kernel26 alsa screen"

KERNEL_IMAGETYPE = "zImage"

IMAGE_FSTYPES ?= "cramfs ubi"

IMAGE_UBI_MIN_IO_SIZE ?= "2048"
IMAGE_UBI_PEB_SIZE ?= "131072"
IMAGE_UBI_SUB_PAGE_SIZE ?= "512"
IMAGE_UBI_CONFIG ?= "[kernel]\\n\
mode=ubi\\n\
image=${DEPLOY_DIR_IMAGE}/zImage-fab4.bin\\n\
vol_id=0\\n\
vol_size=2MiB\\n\
vol_type=static\\n\
vol_name=kernel\\n\
vol_alignment=1\\n\
\\n\
[cramfs]\\n\
mode=ubi\\n\
image=${DEPLOY_DIR_IMAGE}/squeezeos-image-fab4.cramfs\\n\
vol_id=1\\n\
vol_size=40MiB\\n\
vol_type=static\\n\
vol_name=cramfs\\n\
vol_alignment=1\\n\
\\n\
[ubifs]\\n\
mode=ubi\\n\
vol_id=2\\n\
vol_size=20MiB\\n\
vol_type=dynamic\\n\
vol_name=ubifs\\n\
vol_alignment=1\\n\
\\n\
"

SERIAL_CONSOLE = "-L 115200 tts/0"

IMAGE_INSTALL += "jivetest"
IMAGE_INSTALL += "marvell-sdio-module marvell-wlan-tools marvell-wps"

IMAGE_INSTALL += "squeezeplay-fab4"
IMAGE_INSTALL += "squeezeplay-fab4skin"
IMAGE_INSTALL += "squeezeplay-squeezeos"

IMAGE_INSTALL += "squeezecenter"
IMAGE_INSTALL += "samba"
IMAGE_INSTALL += "dhcp-forwarder"
IMAGE_INSTALL += "ntfs-3g"

# Needed for TinySC (squeezecenter) but cannot make it work via IMAGE_INSTALL or RDEPENDS in squeezecenter_svn.bb
IMAGE_INSTALL += "locale-binary-en-us.utf8"

IMAGE_SQUEEZEOS_UPGRADE = "1"
IMAGE_SQUEEZEOS_BOARD_VERSION = "fab4:0002\\n\
fab4:0003\\n\
fab4:0004\\n\
fab4:0005\\n\
fab4:0006\\n\
"

require conf/machine/include/tune-arm1136jf-s.inc
```

## poky/meta-squeezeos/conf/machine/i386-linux.conf
```bitbake
#@TYPE: Machine
#@NAME: qemu x86 Emulator setup
#@DESCRIPTION: Machine configuration for running an x86 system under qemu emulation

TARGET_ARCH = "i586"
IMAGE_FSTYPES ?= "tar.gz"
PACKAGE_EXTRA_ARCHS = "x86"


MACHINE_FEATURES = "kernel26 x86"

GLIBC_ADDONS = "nptl"
GLIBC_EXTRA_OECONF = "--with-tls"

MACHINE_ESSENTIAL_EXTRA_RDEPENDS = "v86d"

TARGET_CC_ARCH = "-march=i586"
```

## poky/meta-squeezeos/conf/machine/jive.conf
```bitbake
#@TYPE: Machine
#@NAME: Logitech Squeezebox Controller (Jive)
#@DESCRIPTION: Machine configuration for the Logitech Squeezebox Controller
TARGET_ARCH = "arm"
PACKAGE_EXTRA_ARCHS = "armv4 armv4t armv5te"

PREFERRED_PROVIDER_virtual/kernel = "linux-jive"

MACHINE_FEATURES = "kernel26 alsa screen"

IMAGE_FSTYPES ?= "cramfs"
SERIAL_CONSOLE = "-L 115200 tts/0"

IMAGE_INSTALL += "uboot-env"
IMAGE_INSTALL += "jivetest"
IMAGE_INSTALL += "marvell-gspi-module marvell-wlan-tools"
IMAGE_INSTALL += "squeezeplay-jive"

IMAGE_SQUEEZEOS_UPGRADE = "1"

require conf/machine/include/tune-arm926ejs.inc
```

## poky/meta-squeezeos/packages/wpasupplicant/files/defconfig
```kconfig
CONFIG_DRIVER_WEXT=y
CONFIG_WIRELESS_EXTENSION=y
CONFIG_IEEE8021X_EAPOL=y
CONFIG_EAP=y
CONFIG_TLS=internal
CONFIG_EAP_TLS=internal
CONFIG_INTERNAL_LIBTOMMATH=y
CONFIG_CTRL_IFACE=y
CONFIG_WPS=y
```

## src/imx35/linux-2.6.24/arch/arm/mach-mx21/Kconfig
```kconfig
menu "MX21 Options"
	depends on ARCH_MX21

config MACH_MX21ADS
	bool "Support MX21 ADS platforms"
	default y
	help
	  Include support for MX21 ADS platform. This includes specific
	  configurations for the board and its peripherals.

endmenu
```

## src/imx35/linux-2.6.24/arch/arm/mach-mxc91321/Kconfig
```kconfig
menu "MXC91321 Options"
	depends on ARCH_MXC91321

choice
	prompt "Board type"
	default MACH_MXC30030EVB

config MACH_MXC30030EVB
	bool "Support MXC300-30 EVB platforms"
	help
	  Include support for MXC300-30 EVB platform. This includes specific
	  configurations for the board and its peripherals.

config MACH_MXC30030ADS
	bool "Support MXC300-30 ADS platforms"
	help
	  Include support for MXC300-30 ADS platform. This includes specific
	  configurations for the board and its peripherals.

endchoice

config MXC_SDMA_API
        bool "Use SDMA API"
        default y
        help
           This selects the Freescale MXC SDMA API.
           If unsure, say N.

config ARCH_MXC_HAS_NFC_V1
        bool "MXC NFC Hardware Version 1"
        default y
        help
           This selects the Freescale MXC Nand Flash Controller Hardware Version 1
           If unsure, say N.

endmenu
```

## src/imx35/linux-2.6.24/drivers/mxc/fab4/Kconfig
```kconfig
#
# fab4 device driver configuration
#

menu "MXC FAB4 support"

config MXC_FAB4_DEBUG_GPIO
	bool "FAB4 Debug GPIO"
	depends on MACH_FAB4
	default n
	---help---
	This driver allows debugging Fab4 GPIOs via the /sys interface.


config MXC_FAB4_IR
	bool "FAB4 IR"
	depends on MACH_FAB4
	default n
	---help---
	This driver provides IR support on Fab4

endmenu
```

## src/imx35/linux-2.6.24/drivers/mxc/pm/Kconfig
```kconfig
#
# Power Managment devices
#

menu "Advanced Power Management devices"

config MXC_DPTC
	bool "MXC DPTC driver"
	depends on (ARCH_MX3 || ARCH_MXC91321) && MXC_PMIC_MC13783
	default y
	help
	   This selects the Freescale MXC Internal DPTC driver.
	   If unsure, say N.

config MX27_DPTC
	bool "MXC DPTC driver"
	depends on ARCH_MX27 && MXC_PMIC_MC13783
	default y
	help
	   This selects the Freescale MX27 Internal DPTC driver.
	   If unsure, say N.

config MXC_DVFS
	bool "MXC DVFS driver"
	depends on ARCH_MX3
	default y
	help
	  This selects the Freescale MXC Internal DVFS driver.
	  If unsure, say N.

config MXC_DVFS_SDMA
	bool "MXC DVFS SDMA support"
	depends on MXC_DVFS
	default n
	help
	  This selects the Freescale MXC Internal DVFS driver SDMA support.
	  If unsure, say N.

endmenu
```

## src/imx35/linux-2.6.24/drivers/mxc/pmic/mc9sdz60/Kconfig
```kconfig
#
# PMIC Modules configuration
#

config MXC_MC9SDZ60_ADC
	tristate "MC9SDZ60 ADC support"
	depends on MXC_PMIC_MC9SDZ60
	default n
	---help---
	This is the MC9SDZ60 ADC module driver. This module provides kernel API
	for the ADC system of MC9SDZ60.
	It controls also the touch screen interface.
	If you want MC9SDZ60 ADC support, you should say Y here

config MXC_MC9SDZ60_RTC
	tristate "MC9SDZ60 Real Time Clock (RTC) support"
	depends on MXC_PMIC_MC9SDZ60
	---help---
	This is the MC9SDZ60 RTC module driver. This module provides kernel API
	for RTC part of MC9SDZ60.
	If you want MC9SDZ60 RTC support, you should say Y here
	
config MXC_MC9SDZ60_POWER
	tristate "MC9SDZ60 Power API support"
	depends on MXC_PMIC_MC9SDZ60
	---help---
	This is the MC9SDZ60 power and supplies module driver. This module provides kernel API
	for power and regulator control part of MC9SDZ60.
	If you want MC9SDZ60 power support, you should say Y here
```
