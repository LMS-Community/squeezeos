## src/imx35/linux-2.6.24/drivers/mxc/security/Kconfig
```kconfig
menu "MXC Security Drivers"

config MXC_SECURITY_SCC
	tristate "MXC SCC Driver"
	default n
	---help---
	  This module contains the core API's for accessing the SCC module.
	  If you are unsure about this, say N here.
config SCC_DEBUG
        bool "MXC SCC Module debugging"
        depends on MXC_SECURITY_SCC
        ---help---
        This is an option for use by developers; most people should
        say N here.  This enables HAC module debugging.

config MXC_SECURITY_SCC2
        tristate "MXC SCC2 Driver"
        depends on ARCH_MX37
        default n
        ---help---
          This module contains the core API's for accessing the SCC2 module.
          If you are unsure about this, say N here.
config SCC_DEBUG
        bool "MXC SCC2 Module debugging"
        depends on MXC_SECURITY_SCC2
        ---help---
        This is an option for use by developers; most people should
        say N here.  This enables HAC module debugging.


config MXC_SECURITY_RNG
	tristate "MXC RNG Driver"
	depends on ARCH_MXC
	depends on !ARCH_MXC91321
	depends on !ARCH_MX27
	default n
	select MXC_SECURITY_CORE
	---help---
	  This module contains the core API's for accessing the RNG module.
	  If you are unsure about this, say N here.

config MXC_RNG_TEST_DRIVER
	bool "MXC RNG debug register"
	depends on MXC_SECURITY_RNG
	default n
	---help---
	  This option enables the RNG kcore driver to provide peek-poke facility
	  into the RNG device registers. Enable this, only for development and
	  testing purposes.
config MXC_RNG_DEBUG
        bool "MXC RNG Module Dubugging"
        depends on MXC_SECURITY_RNG
        default n
        ---help---
         This is an option for use by developers; most people should
         say N here. This enables RNG module debugging.


config MXC_SECURITY_HAC
	tristate "MXC HAC Driver"
	depends on ARCH_MXC
	depends on ARCH_MXC91131
	default n
	select MXC_SECURITY_CORE
	---help---
	  This module contains the core API's for accessing the HAC module.
	  If you are unsure about this, say N here.

config MXC_HAC_TEST_DEBUG
	bool "MXC HAC Module debugging"
	depends on MXC_SECURITY_HAC
	---help---
        This is an option for use by developers; most people should
        say N here.  This enables HAC module debugging.

config MXC_SECURITY_RTIC
	tristate "MXC RTIC Driver"
	depends on ARCH_MXC
	depends on !ARCH_MX21
	default n
	select MXC_SECURITY_CORE
	---help---
	  This module contains the core API's for accessing the RTIC module.
	  If you are unsure about this, say N here.

config MXC_RTIC_TEST_DEBUG
	bool "MXC RTIC module debugging"
	depends on MXC_SECURITY_RTIC
	default n
	---help---
	  This is an option for use by developers; most people should
	  say N here.  This enables RTIC module debugging.

config MXC_SECURITY_CORE
	tristate

if (ARCH_MXC91231 || ARCH_MXC91321 || ARCH_MX27 || ARCH_MXC92323) && MXC_SECURITY_RNG=n && MXC_SECURITY_HAC=n
source "drivers/mxc/security/sahara2/Kconfig"
endif

endmenu
```

## src/imx35/linux-2.6.24/drivers/otg/Kconfig
```kconfig
# @(#) sl@belcarra.com/whiskey.enposte.net|otg/.Makefiles/Kconfig-freescale|20070525074749|60734
# Copyright (c) 2005-2006 Belcarra Technologies 2005 Corp
menu "On-The-Go and USB Peripheral Support"

    config OTG
        tristate "Support for On-The-Go and USB Peripheral Support"
        ---help---
            Configure all or part of the Belcarra OTG Stack


    comment ""

    menu "On-The-Go Support Platform Selection"
        depends on OTG

        source "drivers/otg/hardware/Kconfig-zasevb"
        source "drivers/otg/hardware/Kconfig-zasevb-arc"
        source "drivers/otg/hardware/Kconfig-imx31ads"
        source "drivers/otg/hardware/Kconfig-isp1301"

    endmenu

    source "drivers/otg/Kconfig-otg"

    if ( OTG_ZASEVB != 'n')

		config OTG_NEW_TX_CACHE
			bool 'Use new macro to synchronize TX cache'
			default n
			---help---
			Newer kernels need this set. Turn this off if you get TX_CACHE build errors

    endif



    menu "Targeted Peripherals List (USB Peripheral Function Drivers)"
        depends on OTG_PLATFORM_OTG || OTG_PLATFORM_USBD
        #---help---
        #A list of USB peripheral types that this device
        #can emulate when it is acting as a peripheral.
        source "drivers/otg/functions/generic/Kconfig"
        source "drivers/otg/functions/acm/Kconfig"
        source "drivers/otg/functions/mouse/Kconfig"
        source "drivers/otg/functions/msc/Kconfig"
        source "drivers/otg/functions/network/Kconfig"
#        source "drivers/otg/functions/belcarra/Kconfig"
#        source "drivers/otg/functions/motorola/Kconfig"
#        source "drivers/otg/functions/isotest/Kconfig"
    endmenu

endmenu
```

## src/imx35/linux-2.6.24/drivers/otg/functions/acm/Kconfig
```kconfig
# @(#) tt/root@belcarra.com/debian286.bbb|otg/functions/acm/Kconfig|20070628094342|31231

# Copyright (c) 2005-2006 Belcarra Technologies 2005 Corp

menu "OTG ACM Function"

config OTG_ACM
        tristate "CDC ACM Function"
        depends on OTG
        default OTG

config OTG_ACM_PIPES_TEST
                bool "Pipes Test Only"
                depends on OTG && OTG_ACM && OTG_INTERNAL_TESTING
                default n
                ---help---
                Setting this allows the pipes to be tested separately.

endmenu
```
