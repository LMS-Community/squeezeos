## src/imx35/linux-2.6.24/drivers/otg/functions/network/Kconfig
```kconfig
# @(#) balden@belcarra.com/seth2.rillanon.org|otg/functions/network/Kconfig|20070531044942|29753
# Copyright (c) 2005-2006 Belcarra Technologies 2005 Corp
menu "OTG Network Function"
	depends on OTG

        config OTG_NETWORK

        tristate "USBOTG Network Interface Function Driver"
        depends on OTG
        default OTG


        menu "USBOTG Network Interface Function Driver options"
                depends on OTG_NETWORK

        #comment --
        #comment "Network Device Product Information"

        #config OTG_NETWORK_VENDORID
        #        depends on OTG && OTG_NETWORK
        #        default "0x15ec"
        #	---help---
        #	The USB Peripheral Vendor ID. This should be set to your assigned
        #	USB Vendor ID (www.usb.org). The USB Host will use this and the
        #	Product ID to find and load an appropriate device driver.

        #config OTG_NETWORK_PRODUCTID
        #        hex "ProductID (hex value)"
        #        depends on OTG && OTG_NETWORK
        #        default "0xf001"
        #	---help---
        #	The USB Peripheral Product ID. This should be set to your a
        #	unique value for this product. The USB Host will use this and the
        #	Vendor ID to find and load an appropriate device driver.

        #config OTG_NETWORK_BCDDEVICE
        #        hex "bcdDevice (binary-coded decimal)"
        #        depends on OTG && OTG_NETWORK
        #        default "0x0100"

        #config OTG_NETWORK_MANUFACTURER
        #        string "iManufacturer (string)"
        #        depends on OTG && OTG_NETWORK
        #        default "Belcarra"
        #        ---help---
        #        This will be used as the iManufacturer string descriptor.

        #config OTG_NETWORK_PRODUCT_NAME
        #        string "iProduct (string)"
        #        depends on OTG && OTG_NETWORK
        #        default "Belcarra Network Device"
        #        ---help---
        #        This will be used as the iProduct string descriptor.

        comment --
        comment "Network Protocols"

        config OTG_NETWORK_EEM
                bool 'Enable CDC/EEM'
                default TRUE
                ---help---
                Implement CDC/EEM (Ethernet Emulation Model) support.
                This is the simplest and most efficent protocol available.
                It requires only Bulk IN and Bulk Out endpoints and can
                implement data streaming. It can be used for any type of
                network device.

        config OTG_NETWORK_EEM_CRC
                bool "Append 32bit CRC"
                depends on OTG && OTG_NETWORK_EEM
                default TRUE
                ---help---
                Setting this allows the host and device to verify that
                all network frames have been successfully transferred.

        config OTG_NETWORK_EEM_STREAM
                bool "Streaming mode"
                depends on OTG && OTG_NETWORK_EEM
                default FALSE
                ---help---
                Setting this will tell the EEM driver to stream data as much as
                possible. This usually will result in higher throughput but possibly
                slightly higher latencies.

        config OTG_NETWORK_EEM_ZLE
                bool "Use ZLE not ZLP"
                depends on OTG && OTG_NETWORK_EEM
                default FALSE
                ---help---
                Setting this will force the use of ZLE (Zero Length EEM packet)
                instead of ZLP (Zero Length Packets) when a short packet is required
                to terminate a transfer.

        config OTG_NETWORK_ECM
                bool 'Enable CDC/ECM networking'
                default FALSE
                ---help---
                ECM implements the USB CDC ECM Class Specification Ethernet
                Class Model to support infra-structure devices. This is the
                older style of CDC networking over USB and requires 2 BULK
                (IN and OUT) endpoints, an Interrupt endpoint and the device
                must properly support SET INTERFACE.

        comment --
        comment "Older Network Protocols"

        config OTG_NETWORK_DEPRECATED
                bool "Enable older network protocols"
                default FALSE
                ---help---
                Allow older protocols to be used.

        config OTG_NETWORK_BLAN
                bool 'Enable MDLM-BLAN networking'
                depends on OTG && OTG_NETWORK_DEPRECATED
                default FALSE
                ---help---
                BLAN supports non-infrastructure devices in virtual
                bridged network environment. This protocol is deprecated.

        config OTG_NETWORK_BLAN_CRC
                bool "Append 32bit CRC"
                depends on OTG && OTG_NETWORK_BLAN
                default TRUE
                ---help---
                Setting this allows the host and device to verify that
                all network frames have been successfully transferred.

        config OTG_NETWORK_BLAN_AUTO_CONFIG
                bool "Support Vendor Requests to configure the network interface"
                depends on OTG && OTG_NETWORK_BLAN
                default TRUE
                ---help---
                The driver will automatically configure the network interface
                based on the IPADDR sent from the host to the device during
                enumeration. This eliminates the need for hotplug.

        config OTG_NETWORK_BLAN_NONBRIDGED
                bool "Act as infrastructure device"
                depends on OTG && OTG_NETWORK_BLAN
                default FALSE
                ---help---
                Normally MDLM-BLAN is used to support smart devices in a virtual
                network LAN implemented over USB with the USB Host acting as
                a bridge between itself and all similiar devices. This option
                tells the host to instead treat this as an infrastructure device
                and not participate in the bridge.

        config OTG_NETWORK_SAFE
                bool 'Enable MDLM-SAFE networking'
                depends on OTG && OTG_NETWORK_DEPRECATED
                default FALSE
                ---help---
                SAFE supports infrastructure devices but does not
                require support for SET INTERFACE or interrupt endpoints.
                This protocol is deprecated.

        config OTG_NETWORK_SAFE_CRC
                bool "Append 32bit CRC"
                depends on OTG && OTG_NETWORK_SAFE
                default TRUE
                ---help---
                Setting this allows the host and device to verify that
                all network frames have been successfully transferred.

        config OTG_NETWORK_BASIC
                bool 'Enable Basic network'
                depends on OTG && OTG_NETWORK_DEPRECATED
                default FALSE
                ---help---
                Implement a very simple network configuration
                with a single data interface. This protocol is deprecated.

        config OTG_NETWORK_BASIC2
                bool 'Enable Basic2 network'
                depends on OTG && OTG_NETWORK_DEPRECATED
                default FALSE
                ---help---
                Implement a very simple network configuration with
                two interfaces. This protocol is deprecated.


        #config OTG_NETWORK_START_SINGLE
        #        bool " Start Single Urb Test"
        #        depends on OTG && OTG_NETWORK
        #        default n
        #        ---help---
        #        Used for testing, will not allow multiple receive urbs
        #        to be queued. This will generally slow transfer speeds
        #        and is used to test bus interface drivers operate properly
        #        when there is no receive urb queued.

        #config OTG_NETWORK_EP0TEST
        #        bool " EP0 Test"
        #        depends on OTG && OTG_NETWORK
        #        default n
        #        ---help---
        #        Used for testing, this will change the product string to
        #        a string that is a multiple of the ep0 packetsize. This
        #        can be used to verify that the bus interface driver
        #        properly sends a ZLP after a string.

        comment --
        comment "Linux Network Options)"
        config OTG_NETWORK_HOTPLUG
                bool "Enable additional network hotplug support"
                depends on OTG && HOTPLUG && OTG_NETWORK
                default FALSE
                ---help---
                Enable additional Hotplug support. The network_fd agent script
                will be called with ACTION=attach or ACTION=detach when the
                device is configured or de-configured.

        config OTG_NETWORK_HOTPLUG_PATH
		string "Pathname of master hotplug program"
		depends on OTG && HOTPLUG && OTG_NETWORK && OTG_NETWORK_HOTPLUG
		default  "/usr/sbin/hotplug"


if (OTG != 'y')
        comment --
        comment "Network Device Type and Address configuration (testing)"
        config OTG_NETWORK_TESTING
                bool "Enable auto-config for testing"
                depends on OTG && OTG_NETWORK_EEM
                default FALSE
                ---help---
                Allow older protocols to be used.


        config OTG_NETWORK_INFRASTRUCTURE
                bool 'Infrastructure Device'
                depends on OTG_NETWORK_TESTING
                default FALSE
                ---help---
		The USB Peripheral is implementing networking as an
		infrastructure device. More specifically a device
		that may bridge network frames to another network.
		This will enable a RARPD reply to requests from the
		USB Host for a MAC address (for the host to use.)

        config OTG_NETWORK_RARPD_AUTO_CONFIG
                bool "Automatically configure the network interface using RARPD"
                depends on OTG_NETWORK_TESTING
                default TRUE
                ---help---
                The driver will automatically configure the network interface
                using RARPD. RARPD is an extension to RARP that allows the
                USB Host and USB Peripheral to determine if link level configuration
                of MAC addresses.

        config OTG_NETWORK_RFC868_AUTO_CONFIG
                bool "Set the USB Peripheral System time using RFC868 Time Protocol (UDP)"
                depends on OTG_NETWORK_TESTING
                default TRUE
                ---help---
                The driver will automatically set the system time
                using Time of Day (UDP) Service  (RFC868.)
endif
        endmenu
endmenu
```

## src/imx35/linux-2.6.24/drivers/regulator/Kconfig
```kconfig
menu "Voltage and Current regulators"

config REGULATOR_API
	bool

config REGULATOR
	tristate "Voltage and Current Regulator Support"
	depends on EXPERIMENTAL
	select REGULATOR_API
	default n
	help
	  Generic Voltage and Current Regulator support.

config REGULATOR_DEBUG
	bool "Regulator debug support"
	depends on REGULATOR
	help
	  Say yes here to enable debugging support.

config REGULATOR_MC13783
	tristate "MC13783 Regulator Support"
	depends on REGULATOR
	depends on MXC_PMIC_MC13783
	default y

config REGULATOR_MC13892
	tristate "MC13892 Regulator Support"
	depends on REGULATOR
	depends on MXC_PMIC_MC13892
	default y

config REGULATOR_MAX8660
	tristate "MAX8660 Regulator Support"
	depends on REGULATOR
	depends on MXC_PMIC_MC9SDZ60
	default y

config REGULATOR_WM8350
	tristate "WM8350 Regulator Support"
	depends on REGULATOR

menu "WM8350 Config Mode"
depends on REGULATOR_WM8350

choice
	prompt "WM8350 Configuration Mode"
	default PMIC_WM8350_MODE_0

config PMIC_WM8350_MODE_0
	bool "Mode 0"

config PMIC_WM8350_MODE_1
	bool "Mode 1"

config PMIC_WM8350_MODE_2
	bool "Mode 2"

config PMIC_WM8350_MODE_3
	bool "Mode 3"

endchoice

endmenu

endmenu
```

## src/imx35/linux-2.6.24/drivers/usb/usblan/Kconfig
```kconfig
#
# USB Network devices configuration
#
comment "Belcarra USBLAN Networking for USB"
	depends on USB && NET

config USB_USBLAN
	tristate "Support for Belcarra USBLAN Network Devices"
	depends on USB && NET

config USB_USBLAN_IDS
	bool "Override built-in Vendor and Product ID's"
	depends on USB && NET && USB_USBLAN
	default "n"

config USB_USBLAN_VENDORID
	hex "USB Vendor ID for the USBLAN network device"
	depends on USB_USBLAN && USB_USBLAN_IDS
	default "0"

config USB_USBLAN_PRODUCTID
	hex "USB Product ID for the USBLAN network device"
	depends on USB_USBLAN && USB_USBLAN_IDS
	default "0"
```

## src/imx35/linux-2.6.24/sound/soc/imx/Kconfig
```kconfig
config SND_MXC_SOC
 tristate "SoC Audio for the Freescale i.MX CPU"
 depends on ARCH_MXC && SND
 select SND_PCM
 help
   Say Y or M if you want to add support for codecs attached to
   the MXC I2S or SSP interface. You will also need
   to select the audio interfaces to support below.

config SND_MXC_SOC_SSI
 tristate

config SND_MXC_SOC_ESAI
 tristate

config SND_MXC_SOC_IRAM
 bool "Locate Audio DMA playback buffers in IRAM"
 help 
   Say Y if you don't want Audio playback buffers in external ram
 
config SND_SOC_IMX_3STACK_WM8350
 tristate "SoC Audio support for IMX - WM8350"
 select SND_MXC_SOC_SSI
 select SND_SOC_WM8350
 select REGULATOR_WM8350
 help
   Say Y if you want to add support for SoC audio on IMX 3STACK
   with the WM8350.

config SND_SOC_IMX_3STACK_AK4647
 tristate "SoC Audio support for IMX - AK4647"
 select SND_MXC_SOC_SSI
 select SND_SOC_AK4647
 help
   Say Y if you want to add support for SoC audio on IMX 3STACK
   with the AK4647.

config SND_SOC_IMX_3STACK_WM8580
 tristate "SoC Audio support for IMX - WM8580"
 select SND_MXC_SOC_ESAI
 select SND_SOC_WM8580
 help
   Say Y if you want to add support for Soc audio on IMX 3STACK
   with the WM8580

config SND_SOC_FAB4_AK4420
 tristate "SoC Audio support for Logitech Fab4 - AK4420"
 select SND_MXC_SOC_SSI
 select SND_SOC_AK4420
 help
   Say Y if you want to add support for SoC audio on Logitech Fab4
   with the AK4420.

config SND_SOC_FAB4_WM8974
 tristate "SoC Audio support for Logitech Fab4 - WM8974"
 select SND_MXC_SOC_SSI
 select SND_SOC_WM8974
 help
   Say Y if you want to add support for SoC audio on Logitech Fab4
   with the WM8974.
```
