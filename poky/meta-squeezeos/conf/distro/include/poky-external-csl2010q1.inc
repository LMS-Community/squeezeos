## src/imx35/linux-2.6.24/drivers/otg/functions/generic/Kconfig
```kconfig
# @(#) sp@belcarra.com|otg/functions/generic/Kconfig|20070417200305|49656
menu "OTG Generic function"
        depends on OTG

config OTG_GENERIC
        tristate "Generic Function"
        depends on OTG
        default OTG
        ---help---
        This acts as a generic function, allowing selection of class
        and interface function drivers to create a specific configuration.

menu "OTG Generic Composite function options"
        depends on OTG && OTG_GENERIC

config OTG_GENERIC_VENDORID
        hex "VendorID (hex value)"
        depends on OTG && OTG_GENERIC
        default "0x15ec"

config OTG_GENERIC_PRODUCTID
        hex "ProductID (hex value)"
        depends on OTG && OTG_GENERIC
        default "0xf010"

config OTG_GENERIC_BCDDEVICE
        hex "bcdDevice (binary-coded decimal)"
        depends on OTG && OTG_GENERIC
        default "0x0100"

config OTG_GENERIC_MANUFACTURER
        string "iManufacturer (string)"
        depends on OTG && OTG_GENERIC
        default "Belcarra"

config OTG_GENERIC_PRODUCT_NAME
        string "iProduct (string)"
        depends on OTG && OTG_GENERIC
        default "Generic Composite"

choice
        depends on OTG && OTG_GENERIC
        prompt "Default Composite Driver Configuration"

        config OTG_GENERIC_CONFIG_NONE
        bool 'none'
        help
          No pre-defined selection, use the OTG_GENERIC_CONFIG_NAME instead.

        config OTG_GENERIC_CONFIG_MOUSE
        bool 'mouse'
	depends on OTG_MOUSE
        help
          Configure the mouse driver in a single function non-composite configuration.

        config OTG_GENERIC_CONFIG_NET_EEM
        bool 'cdc-eem'
	depends on OTG_NETWORK_EEM
        help
          Configure the network driver as a single function  CDC EEM non-composite device

        config OTG_GENERIC_CONFIG_NET_BLAN
        bool 'net-blan'
	depends on OTG_NETWORK_BLAN
        help
          Configure the network driver in a single function non-composite BLAN configuration.


        config OTG_GENERIC_CONFIG_NET_CDC
        bool 'net-cdc'
	depends on OTG_NETWORK_ECM
        help
          Configure the network driver in a single function non-composite CDC configuration.

        config OTG_GENERIC_CONFIG_NET_SAFE
        bool 'net-safe'
	depends on OTG_NETWORK_SAFE
        help
          Configure the network driver in a single function non-composite SAFE configuration.


        config OTG_GENERIC_CONFIG_ACM_TTY
        bool 'acm-tty'
	depends on OTG_ACM
        help
          Configure the acm driver in a single function non-composite TTY configuration.


        config OTG_GENERIC_CONFIG_MSC
        bool 'msc'
	depends on OTG_MSC
        help
          Configure the msc driver in a single function non-composite configuration.

        config OTG_GENERIC_CONFIG_HID2_NON_IAD
        bool 'hid2'
	depends on OTG_MOUSE
        help
            Configure a non-IAD composite device with two HID interfaces.

        config OTG_GENERIC_CONFIG_HID2
        bool 'hid2-iad'
	depends on OTG_MOUSE
        help
            Configure an IAD composite device with two HID interfaces.

        config OTG_GENERIC_CONFIG_HID_MSC
        bool 'msc-hid'
	depends on OTG_MSC && OTG_MOUSE
        help
            Configure a non-IAD composite device with mass storage and HID interface.


endchoice

        #config OTG_GENERIC_CONFIG_NAME
        #        string "Composite Configuration (string)"
        #        depends on OTG && OTG_GENERIC && OTG_GENERIC_CONFIG_NONE
        #        default ""
        #        ---help---
        #        Name of predefined configuration to be enabled, note that
        #        if this is not defined (empty string) then the first available
        #        configuration will be used (assuming that the required interface
        #        function drivers are available.

        #config OTG_NETWORK_VENDORID
        #        hex "Network VendorID (hex value)"
        #        depends on OTG && OTG_NETWORK
        #        default "0x15ec"
	#	---help---
	#	The USB Peripheral Vendor ID. This should be set to your assigned
	#	USB Vendor ID (www.usb.org). The USB Host will use this and the
	#	Product ID to find and load an appropriate device driver.

        #comment --
        #comment "USBOTG Network Device Product ID"

        ######################################################################################################3
        #
        # Product ID's for generic cf, non-composite, these are assigned to f00N
        #

        #config OTG_NETWORK_PRODUCT_NAME
        #        string "iProduct (string)"
        #        depends on OTG && OTG_NETWORK
        #        default "Belcarra Network Device"
        #        ---help---
        #        This will be used as the iProduct string descriptor.

        config OTG_GENERIC_PRODUCTID_CDCEEM
                hex "Generic CDC-EEM ProductID (hex value)"
                depends on OTG && OTG_NETWORK
                default "0xf001"
		---help---
		The USB Peripheral Product ID. This should be set to your a
		unique value for this product. The USB Host will use this and the
		Vendor ID to find and load an appropriate device driver.

        config OTG_GENERIC_PRODUCTID_SERIAL
                hex "Generic Serial Port CDC-ACM ProductID (hex value)"
                depends on OTG && OTG_ACM
                default "0xf002"
		---help---
		The USB Peripheral Product ID. This should be set to your a
		unique value for this product. The USB Host will use this and the
		Vendor ID to find and load an appropriate device driver.

        config OTG_GENERIC_PRODUCTID_HID
                hex "Generic HID ProductID (hex value)"
                depends on OTG && OTG_MOUSE
                default "0xf003"
		---help---
		The USB Peripheral Product ID. This should be set to your a
		unique value for this product. The USB Host will use this and the
		Vendor ID to find and load an appropriate device driver.

        config OTG_GENERIC_PRODUCTID_MODEM
                hex "Generic Modem CDC-ACM ProductID (hex value)"
                depends on OTG && OTG_ACM
                default "0xf004"
		---help---
		The USB Peripheral Product ID. This should be set to your a
		unique value for this product. The USB Host will use this and the
		Vendor ID to find and load an appropriate device driver.

        config OTG_GENERIC_PRODUCTID_CDCECM
                hex "Generic CDC-ECM ProductID (hex value)"
                depends on OTG && OTG_NETWORK
                default "0xf005"
		---help---
		The USB Peripheral Product ID. This should be set to your a
		unique value for this product. The USB Host will use this and the
		Vendor ID to find and load an appropriate device driver.

        config OTG_GENERIC_PRODUCTID_MASS
                hex "Generic MASS ProductID (hex value)"
                depends on OTG && OTG_MSC
                default "0xf006"
		---help---
		The USB Peripheral Product ID. This should be set to your a
		unique value for this product. The USB Host will use this and the
		Vendor ID to find and load an appropriate device driver.
        #config OTG_GENERIC_PRODUCTID_COMPOSITE
        #        hex "Composite ProductID (hex value)"
        #        depends on OTG
        #        default "0xf008"
        #        ---help---
        #        The USB Peripheral Product ID. This should be set to your a
        #        unique value for this product. The USB Host will use this and the
        #        Vendor ID to find and load an appropriate device driver.

        #####################################################################################################3
        #
        # Composite ID's are assigned to
        #
        #       c00N
        #

        # c000
        config OTG_GENERIC_PRODUCTID_HID2_NON_IAD
                hex "HID2 Composite ProductID (hex value)"
                depends on OTG && OTG_MOUSE
                default "0xc000"
                ---help---

                hid2_non_iad implements a two interface composite device using
                with two mouse interfaces.

                This configuration does not use IAD (Interface Association Descriptors.
                It will work with Win2k and newer versions of Windows. But
                has been deprecated by the introduction of IAD.  IAD support
                is available in WinXP and newer versions of Windows.

                The USB Peripheral Product ID for the generic hid2 configuration.
                This should be set to your a unique value for this product.
                The USB Host will use this and the Vendor ID to find and
                load an appropriate device driver.

        config OTG_GENERIC_PRODUCTID_HID2
                hex "HID2-IAD Composite ProductID (hex value)"
                depends on OTG && OTG_MOUSE
                default "0xc001"
                ---help---
                hid2 implements a two interface composite device using
                with two mouse interfaces.

                This configuration uses IAD (Interface Association Descriptors.)
                It  will work with WinXP and newer verions of Windows.

                The USB Peripheral Product ID for the hid2 iad
                configuration.  This should be set to your a unique value
                for this product. The USB Host will use this and the Vendor
                ID to find and load an appropriate device driver.

        # c002
        config OTG_GENERIC_PRODUCTID_HID_MSC
                hex "MSC-HID Composite ProductID (hex value)"
                depends on OTG && OTG_MOUSE && OTG_MSC
                default "0xc002"
                ---help---
                hid_msc implements a two interface composite device with
                the mass storage and mouse interfaces.

                This configuration uses IAD (Interface Association Descriptors.)
                It  will work with WinXP and newer verions of Windows.

                The USB Peripheral Product ID for the generic msc-hid
                configuration. This should be set to your a unique value for
                this product. The USB Host will use this and the Vendor ID
                to find and load an appropriate device driver.


        # c003
        config OTG_GENERIC_PRODUCTID_HID_BLAN
                hex "HID-BLAN Composite ProductID (hex value)"
                depends on OTG && OTG_MOUSE && OTG_NETWORK_BLAN
                default "0xc003"
                ---help---
                hid_blan implements a two interface composite device with
                a mouse and blan network interface.

                This configuration uses IAD (Interface Association Descriptors.)

                The USB Peripheral Product ID for the hid-blan
                configuration. This should be set to your a unique value for
                this product. The USB Host will use this and the Vendor ID
                to find and load an appropriate device driver.


        # c004
        config OTG_GENERIC_PRODUCTID_HID_ECM
                hex "HID-ECM Composite ProductID (hex value)"
                depends on OTG && OTG_MOUSE && OTG_NETWORK_ECM
                default "0xc004"
                ---help---
                hid_ecm implements a two interface composite device with
                a mouse and cdc-ecm network interface.

                This configuration uses IAD (Interface Association Descriptors.)

                The USB Peripheral Product ID for the hid-ecm
                configuration. This should be set to your a unique value for
                this product. The USB Host will use this and the Vendor ID
                to find and load an appropriate device driver.


        # c005/c006 serial/modem
        config OTG_GENERIC_PRODUCTID_HID_SERIAL
                hex "HID-SERIAL Composite ProductID (hex value)"
                depends on OTG && OTG_MOUSE && OTG_ACM
                default "0xc005"
                ---help---
                hid_serial implements a two interface composite device with
                a mouse and cdc-acm serial interface.

                This configuration uses IAD (Interface Association Descriptors.)

                The USB Peripheral Product ID for the hid-serial
                configuration. This should be set to your a unique value for
                this product. The USB Host will use this and the Vendor ID
                to find and load an appropriate device driver.

        config OTG_GENERIC_PRODUCTID_HID_MODEM
                hex "HID-MODEM Composite ProductID (hex value)"
                depends on OTG && OTG_MOUSE && OTG_ACM
                default "0xc006"
                ---help---
                hid_serial implements a two interface composite device with
                a mouse and cdc-acm modem interface.

                This configuration uses IAD (Interface Association Descriptors.)

                The USB Peripheral Product ID for the hid-modem
                configuration. This should be set to your a unique value for
                this product. The USB Host will use this and the Vendor ID
                to find and load an appropriate device driver.


        #config OTG_NETWORK_BCDDEVICE
        #        hex "Network bcdDevice (binary-coded decimal)"
        #        depends on OTG && OTG_NETWORK
        #        default "0x0100"


endmenu

endmenu
```
